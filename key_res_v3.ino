#include <avr/wdt.h>
#include <Tablet.h>
//#include <CyberLib.h>
#include <Keyboard.h>
//#include <SPI.h>
#include <Wire.h>
#include <Adafruit_GFX.h>
#include <Adafruit_SH1106.h>
#include <Adafruit_SSD1306.h>
#include <EEPROM.h>
#include "PinChangeInterrupt.h"


#define OLED_RESET 40
Adafruit_SH1106 display(-1);
//Adafruit_SSD1306 displayL(128,32,&Wire,-1);

//#include <fonts/FreeSans9pt7b.h>
#include <fonts/FreeSans12pt7b.h>
//#include <fonts/DSEG14_Modern_Regular_18.h>



boolean clr = 1;
boolean nclr = 0;
boolean upd = 1;
boolean nupd = 0;

//Analog buttons routines//
#define asr_pin A10
boolean asrF;
#define wkL_pin  A1                        // input from left key block on steering wheel
#define wkR_pin  A0                        // input from right key block on steering wheel
volatile uint8_t avg = 10;                     
uint8_t fwddel;
#define key1 526
#define key2 693
#define key3 780
#define key4 826
uint8_t  flagL, flagR;                     // Debounce function for left key block on steering wheel
uint32_t eventR, eventL;                   // Timer for key block on steering wheel
uint32_t commdelay, commdelayV;


// No Sleep routines //
boolean  nsst, acc, flag;
uint32_t nsTime, lastacc, bttime;             //  for NoSleep comand                         
#define btnpin      ((PIND & B00010000)>>4)
#define led_High      PORTC |=B01000000            // No sleep status led output pin
#define led_Low       PORTC &=B10111111
#define pwbtn       ((PINB  & B00010000)>>4)
#define tabpwpress    PORTB  &=B11011111
#define tabpwrel      PORTB  |=B00100000 
#define tabPW       ((PINB & B00000010)>>1)
#define tabON         PORTB |=B00000010
#define tabOFF        PORTB &=B11111101   
#define nsDel 10000

//Encoder routines//
uint32_t enckeytime;                 // Delay for encoder button
volatile uint8_t Epos;
uint8_t enckeyflag;
boolean encmode;
#define enckey   !((PINE & B01000000)>>6)
#define encA 14
#define encB 16


//taho routines
volatile uint32_t    micros_th = 0;
volatile uint16_t    tz        = 0;              //счетчик обнуления
volatile uint16_t    th        = 0;              //обороты
volatile boolean     tt        = false;          //триггер 

//Speed routines
volatile uint32_t    micros_sp = 0;
volatile uint16_t    sz = 0; //счетчик обнуления
volatile uint16_t    sp = 0; //скорость
volatile boolean     st = false; //триггер
volatile uint64_t    odometrPulses;
uint32_t odometr,odosave;
uint64_t tripreset;
float trip;

//Oled routines
uint32_t dispupdTime; 
uint16_t interval = 200;
int8_t  DispPage = 1,  x;

//VoltMeter routines
//float volt;

uint32_t pwbtwait;
uint8_t v;
float ReadVolt[50];

// 'batt icon', 32x32px
const unsigned char batt [] PROGMEM = {
  0x00, 0x00, 0x00, 0x00, 0x00, 0x00, 0x00, 0x00, 0x00, 0x00, 0x00, 0x00, 0x00, 0x00, 0x00, 0x00, 
  0x00, 0x00, 0x00, 0x00, 0x00, 0x00, 0x00, 0x00, 0x01, 0xf0, 0x0f, 0x80, 0x01, 0xf0, 0x0f, 0x80, 
  0x00, 0x00, 0x00, 0x00, 0x00, 0x00, 0x00, 0x00, 0x0f, 0xff, 0xff, 0xf0, 0x1f, 0xff, 0xff, 0xf8, 
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  0x00, 0x00, 0x00, 0x00, 0x00, 0x00, 0x00, 0x00, 0x00, 0x00, 0x00, 0x00, 0x00, 0x00, 0x00, 0x00
};

// 'temp icon', 20x64px
const unsigned char temp [] PROGMEM = {
  0x00, 0x00, 0x00, 0x01, 0xf8, 0x00, 0x03, 0xfc, 0x00, 0x07, 0x0e, 0x00, 0x06, 0x06, 0x00, 0x06, 
  0x06, 0x00, 0x06, 0x06, 0x00, 0x06, 0x06, 0x00, 0x06, 0x06, 0x00, 0x06, 0x06, 0x00, 0x06, 0x06, 
  0x00, 0x06, 0x06, 0x00, 0x06, 0x06, 0x00, 0x06, 0x66, 0x00, 0x06, 0x66, 0x00, 0x06, 0x66, 0x00, 
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  0xc0, 0x1c, 0x03, 0x80, 0x1e, 0x07, 0x80, 0x0f, 0xff, 0x00, 0x03, 0xfc, 0x00, 0x00, 0x00, 0x00
};



void setup() {
//  wdt_enable(WDTO_8S);
 //ReadEEprom();
 EEPROM.get(0,odometrPulses);
 EEPROM.get(10, tripreset);
 avg =  EEPROM.read(18) ;

 initDisplay();
 SetupPins();
  
  attachPCINT(digitalPinToPCINT(encA), enc, CHANGE);
  attachPCINT(digitalPinToPCINT(encB), enc, CHANGE);
  attachInterrupt(3, tahometr,   RISING);
  attachInterrupt(2, speedometr, RISING);
  Serial.begin(115200);              
  Keyboard.begin(); 
  
          
 }

void loop(){

 // wdt_reset();

  if(millis() - pwbtwait > 1500){
  (pwbtn) ? tabpwrel:tabpwpress;}
  acc = ((PINF & B00010000)>>4); 

  //Serial.println(volt);
  btnst();
 
 if(acc || nsst) { 
     lastacc = millis(); flag = 0;  
   if(!tabPW) {initDisplay(); StartTablet();} 
   if(millis() - dispupdTime > interval){ disupd(); dispupdTime = millis(); }
   if(!nsst){if( millis() - nsTime > nsDel || flag) {keypress(205); nsTime = millis(); }} //// No sleep command 205

  Enckey(); wkl(); wkr(); ASR(); avg = constrain(avg,10,50); //Tablet.clear();
  
  if(v < 49) {v++;} else {v = 0;} ReadVolt[v] = ((analogRead(A3)*4.90)/1023.0)/(1000.0/(2000.0+1000.0));
  
  if(millis()-odosave > 120000){EEPROM.put(0,odometrPulses); odosave = millis();}

}
  else if(millis() - lastacc > 3000 && !flag) { EEPROM.put(0,odometrPulses); avd(); }
  else if(millis() - lastacc > 300000 && !nsst && btnpin) {GoSleep(); ;}

    if(tz != 0){tz--;}else{th = 0;}; 
    if(sz != 0){sz--;}else{sp = 0;};
} // End Loop
